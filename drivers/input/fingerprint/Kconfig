## drivers/input/fingerprint/Kconfig
```kconfig
#
#Fingerprint
#
menu "Fingerprint support"
	depends on INPUT

config MTK_FINGERPRINT_SUPPORT
	bool "Mediatek Fingerprint"
	default y
	help
	  Fingerprint mtk driver enable/disable
	  in the kernel.Say Y here if you want to
	  use mediatek fingerprint driver,fingerprint
	  driver will support fingerprint function

config MICROARRAY_FINGERPRINT
	bool "Microarray Fingerprint"
	default y
	---help---
	Microarray fingerprint Microarray's 121/112/88/64/48 device.

if MICROARRAY_FINGERPRINT = ""
config MTK_FINGERPRINT_SELECT
	string "sensor type"
	default "GF318M"
endif

config FPSENSOR_TEE
	bool "FPSensor TEE Fingerprint"
	default y
	help
	  FPSensor TEE fingerprint support

endmenu
```
